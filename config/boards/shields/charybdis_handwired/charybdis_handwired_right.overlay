#include "charybdis_handwired.dtsi"

&default_transform {
    col-offset = <5>;
};

// https://zmk.dev/docs/development/hardware-integration/new-shield implies this order should be flipped,
// but I wired according to ./charybdis_wiring_col_row.png
&kscan0 {
    col-gpios
        = <&gpio1 13 GPIO_ACTIVE_HIGH>
        , <&gpio1 11 GPIO_ACTIVE_HIGH>
        , <&gpio0 10 GPIO_ACTIVE_HIGH>
        , <&gpio0 4 GPIO_ACTIVE_HIGH>
        , <&gpio0 11 GPIO_ACTIVE_HIGH>
        ;
};