## config/boards/shields/charybdis_handwired/Kconfig.defconfig
```kconfig
if SHIELD_CHARYBDIS_HANDWIRED_RIGHT

config ZMK_KEYBOARD_NAME
    default "Charybdis"

config ZMK_SPLIT_ROLE_CENTRAL
    default y

endif

if SHIELD_CHARYBDIS_HANDWIRED_LEFT || SHIELD_CHARYBDIS_HANDWIRED_RIGHT

config ZMK_SPLIT
    default y

endif
```

## config/boards/shields/charybdis_handwired/Kconfig.shield
```kconfig
config SHIELD_CHARYBDIS_HANDWIRED_LEFT
    def_bool $(shields_list_contains,charybdis_handwired_left)

config SHIELD_CHARYBDIS_HANDWIRED_RIGHT
    def_bool $(shields_list_contains,charybdis_handwired_right)
```

## config/west.yml
```yaml
# This file specifies the build dependencies for Github Action workflows and
# for local build environments. The workspace has three toplevel directories
# containing the user config, user modules and ZMK. Zephyr and its dependencies
# are namespaced under /zmk to keep the toplevel clean.
#
# ZMK-Workspace
# ├── config
# ├── modules (user modules)
# └── zmk
#     └── modules (Zephyr modules)
#
# To create a local build environment, clone this repository and then run the
# following commands from its toplevel directory:
#
# $ west init -l config
# $ west update
# $ west zephyr-export
#
---
manifest:
  defaults:
    remote: urob

  remotes:
    - name: upstream
      url-base: https://github.com/zmkfirmware
    - name: urob
      url-base: https://github.com/urob
    - name: inorichi
      url-base: https://github.com/inorichi

  projects:
    - name: zmk-helpers
      revision: main
      path: modules/helpers
    - name: zmk-auto-layer
      revision: main
      path: modules/auto-layer
    - name: zmk-tri-state
      revision: main
      path: modules/tri-state

    # ZMK with Zephyr namespaced under /zmk. This requires that ZMK imports
    # Zephyr with a path other than `zephyr` (as in `going-modular`).
    - name: zmk
      revision: going-modular
      path: .
      import:
        file: app/west.yml
        path-prefix: zmk

    # PMW3610 driver (I'm using a PMW3360 from the ximi)
    # https://github.com/inorichi/zmk-pmw3610-driver
    # - name: zmk
    #   remote: zmkfirmware
    #   revision: feat/pointers-move-scroll
    #   import: app/west.yml
    # - name: zmk-pmw3610-driver
    #   remote: inorichi
    #   revision: main

  self:
    path: config
```
